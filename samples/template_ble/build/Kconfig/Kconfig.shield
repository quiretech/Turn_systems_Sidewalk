## samples/template_ble/build/Kconfig/Kconfig.shield
```kconfig
osource "c:/ncs/v2.5.0/turn_systems_sidewalk/samples/template_ble/boards/shields/*/Kconfig.shield"
osource "c:/ncs/v2.5.0/sidewalk/samples/template_ble/boards/shields/*/Kconfig.shield"
osource "C:/ncs/v2.5.0/nrf/boards/shields/*/Kconfig.shield"
```

## samples/template_ble/build/Kconfig/Kconfig.shield.defconfig
```kconfig
osource "c:/ncs/v2.5.0/turn_systems_sidewalk/samples/template_ble/boards/shields/*/Kconfig.defconfig"
osource "c:/ncs/v2.5.0/sidewalk/samples/template_ble/boards/shields/*/Kconfig.defconfig"
osource "C:/ncs/v2.5.0/nrf/boards/shields/*/Kconfig.defconfig"
```
